## buildroot_defconfig
```kconfig
# adopted from configs/raspberrypi0w_defconfig

# Architecture
BR2_arm=y
BR2_arm1176jzf_s=y
BR2_ARM_EABIHF=y

BR2_TOOLCHAIN_BUILDROOT_CXX=y

BR2_SYSTEM_DHCP="eth0"

# Image
BR2_ROOTFS_POST_BUILD_SCRIPT="$(BR2_EXTERNAL_KUBERNETES_PATH)/post_build.sh"

# Linux headers same as kernel, a 4.19 series
BR2_PACKAGE_HOST_LINUX_HEADERS_CUSTOM_4_19=y

# Kernel
BR2_LINUX_KERNEL=y
BR2_LINUX_KERNEL_CUSTOM_TARBALL=y
BR2_LINUX_KERNEL_CUSTOM_TARBALL_LOCATION="$(call github,raspberrypi,linux,4f2a4cc501c428c940549f39d5562e60404ac4f7)/linux-4f2a4cc501c428c940549f39d5562e60404ac4f7.tar.gz"
BR2_LINUX_KERNEL_USE_CUSTOM_CONFIG=y
BR2_LINUX_KERNEL_CUSTOM_CONFIG_FILE="$(BR2_EXTERNAL_KUBERNETES_PATH)/linux.config"

# Build the DTB from the kernel sources
BR2_LINUX_KERNEL_DTS_SUPPORT=y
BR2_LINUX_KERNEL_INTREE_DTS_NAME="bcm2708-rpi-zero-w"

BR2_LINUX_KERNEL_NEEDS_HOST_OPENSSL=y

BR2_PACKAGE_RPI_FIRMWARE=y

# Required tools to create the SD image
BR2_PACKAGE_HOST_DOSFSTOOLS=y
BR2_PACKAGE_HOST_GENIMAGE=y
BR2_PACKAGE_HOST_MTOOLS=y

# Filesystem / image
BR2_TARGET_ROOTFS_EXT2=y
BR2_TARGET_ROOTFS_EXT2_4=y
BR2_TARGET_ROOTFS_EXT2_SIZE="550M"
# BR2_TARGET_ROOTFS_TAR is not set
#BR2_ROOTFS_POST_BUILD_SCRIPT="board/raspberrypi0w/post-build.sh"
BR2_ROOTFS_POST_IMAGE_SCRIPT="board/raspberrypi0w/post-image.sh"
BR2_ROOTFS_POST_SCRIPT_ARGS="--add-miniuart-bt-overlay"

# Wifi
BR2_PACKAGE_RPI_WIFI_FIRMWARE=y
BR2_PACKAGE_WIRELESS_REGDB=y
BR2_PACKAGE_WPA_SUPPLICANT=y
BR2_PACKAGE_WPA_SUPPLICANT_NL80211=y

#######################################################################

BR2_ROOTFS_OVERLAY="$(BR2_EXTERNAL_KUBERNETES_PATH)/rootfs-overlay"

BR2_CCACHE=y

BR2_PACKAGE_HAVEGED=y
BR2_PACKAGE_E2FSPROGS=y
BR2_PACKAGE_CA_CERTIFICATES=y
BR2_PACKAGE_OPENSSH=y

# Img
BR2_PACKAGE_E2FSPROGS_RESIZE2FS=y

# Docker
BR2_PACKAGE_DOCKER_CONTAINERD=n
BR2_PACKAGE_DOCKER_ENGINE=n
BR2_PACKAGE_K3C=y
BR2_PACKAGE_DOCKER_CLI=n

# Systemd
BR2_TOOLCHAIN_BUILDROOT_GLIBC=y
BR2_SSP_REGULAR=y
BR2_INIT_SYSTEMD=y

# Networking
BR2_PACKAGE_IPTABLES=y
BR2_PACKAGE_EBTABLES=y
BR2_PACKAGE_ETHTOOL=y
BR2_PACKAGE_SOCAT=y
BR2_PACKAGE_CONNTRACK_TOOLS=y
BR2_PACKAGE_UTIL_LINUX=y
BR2_PACKAGE_UTIL_LINUX_NSENTER=y
BR2_PACKAGE_BRIDGE_UTILS=y
BR2_PACKAGE_IPSET=y

# Miscellanous
BR2_PACKAGE_PSMISC=y
BR2_PACKAGE_BASH=y

# Kubernetes
BR2_PACKAGE_KUBERNETES=n
BR2_PACKAGE_CRI_TOOLS=n
BR2_PACKAGE_K3S=y
BR2_PACKAGE_CNI_PLUGINS=y
```

## external/configs/kubernetes_aarch64_defconfig
```kconfig
# adopted from configs/raspberrypi3_64_defconfig

# Architecture
BR2_aarch64=y
BR2_cortex_a53=y
BR2_ARM_FPU_VFPV4=y

BR2_TOOLCHAIN_BUILDROOT_CXX=y

# System
BR2_SYSTEM_DHCP="eth0"

# Required tools to create bootable media
BR2_PACKAGE_HOST_DOSFSTOOLS=y
BR2_PACKAGE_HOST_GENIMAGE=y
BR2_PACKAGE_HOST_MTOOLS=y

# Bootloader
BR2_TARGET_GRUB2=y
BR2_TARGET_GRUB2_INSTALL_TOOLS=y

# Filesystem / image
BR2_TARGET_ROOTFS_EXT2=y
BR2_TARGET_ROOTFS_EXT2_4=y
BR2_TARGET_ROOTFS_EXT2_SIZE="650M"
# BR2_TARGET_ROOTFS_TAR is not set
BR2_ROOTFS_POST_BUILD_SCRIPT="$(BR2_EXTERNAL_KUBERNETES_PATH)/board/kubernetes/aarch64/post-build.sh"
BR2_ROOTFS_POST_IMAGE_SCRIPT="$(BR2_EXTERNAL_KUBERNETES_PATH)/board/kubernetes/aarch64/post-image.sh"
BR2_ROOTFS_POST_SCRIPT_ARGS="--aarch64 --add-miniuart-bt-overlay"

# Linux headers same as kernel, a 5.4 series
BR2_PACKAGE_HOST_LINUX_HEADERS_CUSTOM_5_4=y


# Kernel
BR2_LINUX_KERNEL=y
BR2_LINUX_KERNEL_CUSTOM_TARBALL=y
BR2_LINUX_KERNEL_CUSTOM_TARBALL_LOCATION="$(call github,raspberrypi,linux,ec0dcf3064b8ba99f226438214407fcea9870f76)/linux-ec0dcf3064b8ba99f226438214407fcea9870f76.tar.gz"
BR2_LINUX_KERNEL_USE_CUSTOM_CONFIG=y
BR2_LINUX_KERNEL_CUSTOM_CONFIG_FILE="$(BR2_EXTERNAL_KUBERNETES_PATH)/board/kubernetes/aarch64/linux.config"
BR2_LINUX_KERNEL_NEEDS_HOST_OPENSSL=y

# Build the DTB from the kernel sources
BR2_LINUX_KERNEL_DTS_SUPPORT=y
BR2_LINUX_KERNEL_INTREE_DTS_NAME="broadcom/bcm2710-rpi-3-b broadcom/bcm2710-rpi-3-b-plus broadcom/bcm2837-rpi-3-b"


# Firmware
BR2_PACKAGE_RPI_FIRMWARE=y
BR2_PACKAGE_RPI_FIRMWARE_BOOTCODE_BIN=y
BR2_PACKAGE_RPI_FIRMWARE_VARIANT_PI=y
BR2_PACKAGE_RPI_FIRMWARE_CONFIG_FILE="$(BR2_EXTERNAL_KUBERNETES_PATH)/board/kubernetes/aarch64/config_3_64bit.txt"

# Packages
#

#######################################################################

BR2_GLOBAL_PATCH_DIR="$(BR2_EXTERNAL_KUBERNETES_PATH)/patches"
BR2_ROOTFS_OVERLAY="$(BR2_EXTERNAL_KUBERNETES_PATH)/rootfs-overlay"

BR2_CCACHE=y

BR2_PACKAGE_HAVEGED=y
BR2_PACKAGE_E2FSPROGS=y
BR2_PACKAGE_CA_CERTIFICATES=y
BR2_PACKAGE_OPENSSH=y

# Img
BR2_PACKAGE_E2FSPROGS_RESIZE2FS=y

# Docker
BR2_PACKAGE_DOCKER_ENGINE=y
BR2_PACKAGE_CRI_DOCKERD=y
BR2_PACKAGE_DOCKER_CLI=y

# Systemd
BR2_TOOLCHAIN_BUILDROOT_GLIBC=y
BR2_SSP_REGULAR=y
BR2_INIT_SYSTEMD=y

# Networking
BR2_PACKAGE_IPTABLES_NFTABLES=y
BR2_PACKAGE_EBTABLES=y
BR2_PACKAGE_ETHTOOL=y
BR2_PACKAGE_SOCAT=y
BR2_PACKAGE_CONNTRACK_TOOLS=y
BR2_PACKAGE_UTIL_LINUX_NSENTER=y
BR2_PACKAGE_BRIDGE_UTILS=y
BR2_PACKAGE_IPSET=y

# Filesystem
BR2_PACKAGE_NFS_UTILS=y

# Miscellanous
BR2_PACKAGE_PSMISC=y
BR2_PACKAGE_BASH=y

# Kubernetes
BR2_PACKAGE_KUBERNETES=y
BR2_PACKAGE_KUBERNETES_KUBEADM=y
BR2_PACKAGE_KUBERNETES_KUBELET=y
BR2_PACKAGE_KUBERNETES_KUBECTL=y
BR2_PACKAGE_HOST_KUBERNETES_KUBEADM=n
BR2_PACKAGE_HOST_KUBERNETES_KUBECTL=n
BR2_PACKAGE_CRI_TOOLS=y
BR2_PACKAGE_CNI_PLUGINS=y
```

## external/configs/kubernetes_x86_64_defconfig
```kconfig
# adopted from configs/pc_x86_64_bios_defconfig

# Architecture
BR2_x86_64=y

# System
BR2_TARGET_GENERIC_GETTY_PORT="tty1"
BR2_SYSTEM_DHCP="eth0"

# Required tools to create bootable media
BR2_PACKAGE_HOST_GENIMAGE=y

# Bootloader
BR2_TARGET_GRUB2=y
BR2_TARGET_GRUB2_INSTALL_TOOLS=y

# Filesystem / image
BR2_TARGET_ROOTFS_EXT2=y
BR2_TARGET_ROOTFS_EXT2_4=y
BR2_TARGET_ROOTFS_EXT2_SIZE="650M"
# BR2_TARGET_ROOTFS_TAR is not set
BR2_ROOTFS_POST_BUILD_SCRIPT="$(BR2_EXTERNAL_KUBERNETES_PATH)/board/kubernetes/x86_64/post-build.sh"
BR2_ROOTFS_POST_IMAGE_SCRIPT="support/scripts/genimage.sh"
BR2_ROOTFS_POST_SCRIPT_ARGS="-c $(BR2_EXTERNAL_KUBERNETES_PATH)/board/kubernetes/x86_64/genimage-bios.cfg"

# Linux headers same as kernel, a 5.4 series
BR2_PACKAGE_HOST_LINUX_HEADERS_CUSTOM_5_4=y


# Kernel
BR2_LINUX_KERNEL=y
BR2_LINUX_KERNEL_CUSTOM_VERSION=y
BR2_LINUX_KERNEL_CUSTOM_VERSION_VALUE="5.4.182"
BR2_LINUX_KERNEL_USE_CUSTOM_CONFIG=y
BR2_LINUX_KERNEL_CUSTOM_CONFIG_FILE="$(BR2_EXTERNAL_KUBERNETES_PATH)/board/kubernetes/x86_64/linux.config"
BR2_LINUX_KERNEL_INSTALL_TARGET=y
BR2_LINUX_KERNEL_NEEDS_HOST_OPENSSL=y

# Firmware
# BR2_PACKAGE_LINUX_FIRMWARE is not set

# Packages
#
# acpid is for seamless power button support
BR2_PACKAGE_ACPID=y

#######################################################################

BR2_GLOBAL_PATCH_DIR="$(BR2_EXTERNAL_KUBERNETES_PATH)/patches"
BR2_ROOTFS_OVERLAY="$(BR2_EXTERNAL_KUBERNETES_PATH)/rootfs-overlay"

BR2_CCACHE=y

BR2_PACKAGE_HAVEGED=y
BR2_PACKAGE_E2FSPROGS=y
BR2_PACKAGE_CA_CERTIFICATES=y
BR2_PACKAGE_OPENSSH=y

# Img
BR2_PACKAGE_E2FSPROGS_RESIZE2FS=y

# Docker
BR2_PACKAGE_DOCKER_ENGINE=y
BR2_PACKAGE_CRI_DOCKERD=y
BR2_PACKAGE_DOCKER_CLI=y

# Systemd
BR2_TOOLCHAIN_BUILDROOT_GLIBC=y
BR2_SSP_REGULAR=y
BR2_INIT_SYSTEMD=y

# Networking
BR2_PACKAGE_IPTABLES_NFTABLES=y
BR2_PACKAGE_EBTABLES=y
BR2_PACKAGE_ETHTOOL=y
BR2_PACKAGE_SOCAT=y
BR2_PACKAGE_CONNTRACK_TOOLS=y
BR2_PACKAGE_UTIL_LINUX_NSENTER=y
BR2_PACKAGE_BRIDGE_UTILS=y
BR2_PACKAGE_IPSET=y

# Filesystem
BR2_PACKAGE_NFS_UTILS=y

# Miscellanous
BR2_PACKAGE_PSMISC=y
BR2_PACKAGE_BASH=y

# Kubernetes
BR2_PACKAGE_KUBERNETES=y
BR2_PACKAGE_KUBERNETES_KUBEADM=y
BR2_PACKAGE_KUBERNETES_KUBELET=y
BR2_PACKAGE_KUBERNETES_KUBECTL=y
BR2_PACKAGE_HOST_KUBERNETES_KUBEADM=n
BR2_PACKAGE_HOST_KUBERNETES_KUBECTL=n
BR2_PACKAGE_CRI_TOOLS=y
BR2_PACKAGE_CNI_PLUGINS=y
```

## external/package/Config.in
```kconfig
menu "Kubernetes"
    source "$BR2_EXTERNAL_KUBERNETES_PATH/package/kubernetes/Config.in"
    source "$BR2_EXTERNAL_KUBERNETES_PATH/package/kubernetes-kubeadm/Config.in"
    source "$BR2_EXTERNAL_KUBERNETES_PATH/package/kubernetes-kubelet/Config.in"
    source "$BR2_EXTERNAL_KUBERNETES_PATH/package/kubernetes-kubectl/Config.in"
    source "$BR2_EXTERNAL_KUBERNETES_PATH/package/cri-tools/Config.in"
    source "$BR2_EXTERNAL_KUBERNETES_PATH/package/cri-dockerd/Config.in"
    source "$BR2_EXTERNAL_KUBERNETES_PATH/package/cni-plugins/Config.in"
    source "$BR2_EXTERNAL_KUBERNETES_PATH/package/cni-plugin-flannel/Config.in"
    source "$BR2_EXTERNAL_KUBERNETES_PATH/package/k3s/Config.in"
    source "$BR2_EXTERNAL_KUBERNETES_PATH/package/k3c/Config.in"
endmenu

source "$BR2_EXTERNAL_KUBERNETES_PATH/package/Config.in.host"
```

## external/package/Config.in.host
```kconfig
menu "Host utilities"
    source "$BR2_EXTERNAL_KUBERNETES_PATH/package/kubernetes-kubeadm/Config.in.host"
    source "$BR2_EXTERNAL_KUBERNETES_PATH/package/kubernetes-kubectl/Config.in.host"
endmenu
```

## external/package/cni-plugin-flannel/Config.in
```kconfig
config BR2_PACKAGE_CNI_PLUGIN_FLANNEL
	bool "cni-plugin-flannel"
	depends on BR2_PACKAGE_HOST_GO_TARGET_ARCH_SUPPORTS
	help
	  Flannel CNI network plugin.
```

## external/package/cni-plugins/Config.in
```kconfig
config BR2_PACKAGE_CNI_PLUGINS
	bool "cni-plugins"
	depends on BR2_PACKAGE_HOST_GO_TARGET_ARCH_SUPPORTS
	help
	  Some CNI network plugins, maintained by the containernetworking team.

if BR2_PACKAGE_CNI_PLUGINS

config BR2_PACKAGE_CNI_PLUGINS_BASIC
	bool "basic plugins"
        default y
	select BR2_PACKAGE_CNI_PLUGIN_FLANNEL
	help
	  Install basic plugins

config BR2_PACKAGE_CNI_PLUGINS_EXTRA
	bool "extra plugins"
        default n
	help
	  Install extra plugins

endif
```

## external/package/cri-tools/Config.in
```kconfig
config BR2_PACKAGE_CRI_TOOLS
	bool "cri-tools"
	depends on BR2_PACKAGE_HOST_GO_TARGET_ARCH_SUPPORTS
	help
	  CLI and validation tools for Kubelet Container Runtime Interface (CRI)

if BR2_PACKAGE_CRI_TOOLS

config BR2_PACKAGE_CRI_TOOLS_CRICTL
	bool "crictl binary"
        default y
	help
	  Install crictl binary

config BR2_PACKAGE_CRI_TOOLS_CRITEST
	bool "critest binary"
        default n
	help
	  Install critest binary

endif
```

## external/package/k3c/Config.in
```kconfig
config BR2_PACKAGE_K3C
	bool "k3c"
	depends on BR2_PACKAGE_HOST_GO_TARGET_ARCH_SUPPORTS
	select BR2_PACKAGE_RUNC # runtime dependency
	help
	  Classic Docker for a Kubernetes World

	  https://github.com/rancher/k3c
```

## external/package/k3s/Config.in
```kconfig
config BR2_PACKAGE_K3S
	bool "k3s"
	depends on BR2_PACKAGE_HOST_GO_TARGET_ARCH_SUPPORTS
	depends on !BR2_PACKAGE_KUBERNETES_KUBECTL
	depends on !BR2_PACKAGE_CRI_TOOLS_CRICTL
	select BR2_PACKAGE_RUNC # runtime dependency
	select BR2_PACKAGE_CNI_PLUGINS
	help
	  Lightweight Kubernetes ("5 less than k8s")

	  https://k3s.io/
```

## external/package/kine/Config.in
```kconfig
config BR2_PACKAGE_KINE
	bool "kine"
	depends on BR2_PACKAGE_HOST_GO_TARGET_ARCH_SUPPORTS
	help
	  Kine (Kine is not etcd) is an etcdshim that translates etcd API to sql
```

## external/package/kubernetes-kubeadm/Config.in.host
```kconfig
config BR2_PACKAGE_HOST_KUBERNETES_KUBEADM
	bool "host kubernetes-kubeadm"
	depends on BR2_PACKAGE_KUBERNETES
	depends on BR2_PACKAGE_HOST_GO_HOST_ARCH_SUPPORTS
	help
	  Production-Grade Container Orchestration

	  https://kubernetes.io/
```

## external/package/kubernetes-kubectl/Config.in
```kconfig
config BR2_PACKAGE_KUBERNETES_KUBECTL
	bool "kubernetes-kubectl"
        depends on BR2_PACKAGE_KUBERNETES
	depends on BR2_PACKAGE_HOST_GO_TARGET_ARCH_SUPPORTS
	help
	  Production-Grade Container Orchestration

	  https://kubernetes.io/
```

## external/package/kubernetes-kubectl/Config.in.host
```kconfig
config BR2_PACKAGE_HOST_KUBERNETES_KUBECTL
	bool "host kubernetes-kubectl"
	depends on BR2_PACKAGE_KUBERNETES
	depends on BR2_PACKAGE_HOST_GO_HOST_ARCH_SUPPORTS
	help
	  Production-Grade Container Orchestration

	  https://kubernetes.io/
```

## external/package/kubernetes/Config.in
```kconfig
config BR2_PACKAGE_KUBERNETES
	bool "kubernetes"
	help
	  Production-Grade Container Orchestration

	  https://kubernetes.io/
```

## external/package/nomad-containerd/Config.in
```kconfig
config BR2_PACKAGE_NOMAD_CONTAINERD
	bool "nomad-containerd"
	depends on BR2_PACKAGE_HOST_GO_TARGET_ARCH_SUPPORTS
	help
	  Nomad driver for containerd

	  https://www.nomadproject.io/
```

## external/package/nomad-driver-containerd/Config.in
```kconfig
config BR2_PACKAGE_NOMAD_DRIVER_CONTAINERD
	bool "nomad-driver-containerd"
	depends on BR2_PACKAGE_HOST_GO_TARGET_ARCH_SUPPORTS
	help
	  Nomad driver for containerd

	  https://www.nomadproject.io/
```

## external/package/nomad/Config.in
```kconfig
config BR2_PACKAGE_NOMAD
	bool "nomad"
	depends on BR2_PACKAGE_HOST_GO_TARGET_ARCH_SUPPORTS
	help
	  Nomad - Workload Orchestration

	  https://www.nomadproject.io/
```

## kernel_defconfig
```kconfig
# board/pc/linux.config (bios)
# disabled wireless support too

CONFIG_SYSVIPC=y
CONFIG_MODULES=y
CONFIG_MODULE_UNLOAD=y
CONFIG_SMP=y
CONFIG_HYPERVISOR_GUEST=y
CONFIG_PARAVIRT=y
CONFIG_EFI=n
CONFIG_NET=y
CONFIG_PACKET=y
CONFIG_UNIX=y
CONFIG_INET=y
CONFIG_NETFILTER=y
CONFIG_IP_NF_IPTABLES=y
CONFIG_IP_NF_FILTER=y
# CONFIG_WIRELESS is not set
CONFIG_DEVTMPFS=y
CONFIG_DEVTMPFS_MOUNT=y
CONFIG_VIRTIO_BLK=y
CONFIG_BLK_DEV_SD=y
CONFIG_SCSI_VIRTIO=y
CONFIG_ATA=y
CONFIG_ATA_PIIX=y
CONFIG_NETDEVICES=y
CONFIG_VIRTIO_NET=y
CONFIG_NE2K_PCI=y
CONFIG_8139CP=y
# CONFIG_WLAN is not set
CONFIG_INPUT_EVDEV=y
CONFIG_SERIAL_8250=y
CONFIG_SERIAL_8250_CONSOLE=y
CONFIG_VIRTIO_CONSOLE=y
CONFIG_HW_RANDOM_VIRTIO=m
CONFIG_DRM=y
CONFIG_DRM_I915=y
CONFIG_DRM_QXL=y
CONFIG_DRM_BOCHS=y
CONFIG_DRM_VIRTIO_GPU=y
CONFIG_FB_VESA=y
CONFIG_SOUND=y
CONFIG_SND=y
CONFIG_SND_HDA_INTEL=y
CONFIG_SND_HDA_GENERIC=y
CONFIG_USB=y
CONFIG_USB_XHCI_HCD=y
CONFIG_USB_EHCI_HCD=y
CONFIG_USB_UHCI_HCD=y
CONFIG_USB_STORAGE=y
CONFIG_VIRTIO_PCI=y
CONFIG_VIRTIO_BALLOON=y
CONFIG_VIRTIO_INPUT=y
CONFIG_VIRTIO_MMIO=y
CONFIG_VIRTIO_MMIO_CMDLINE_DEVICES=y
CONFIG_EXT4_FS=y
CONFIG_FUSE_FS=y
CONFIG_TMPFS_POSIX_ACL=y
CONFIG_SQUASHFS=y
CONFIG_UNWINDER_FRAME_POINTER=y

# docker contrib/check-config.sh

CONFIG_NETFILTER=y
CONFIG_NETFILTER_ADVANCED=y
CONFIG_NF_CONNTRACK=m
CONFIG_IP_NF_IPTABLES=m

# necessary
CONFIG_NAMESPACES=y
CONFIG_NET_NS=y
CONFIG_PID_NS=y
CONFIG_IPC_NS=y
CONFIG_UTS_NS=y
CONFIG_CGROUPS=y
CONFIG_CGROUP_CPUACCT=y
CONFIG_CGROUP_DEVICE=y
CONFIG_CGROUP_FREEZER=y
CONFIG_CGROUP_SCHED=y
CONFIG_CPUSETS=y
CONFIG_MEMCG=y
CONFIG_KEYS=y
CONFIG_VETH=m
CONFIG_BRIDGE=y
CONFIG_BRIDGE_NETFILTER=m
CONFIG_NF_NAT_IPV4=m
CONFIG_IP_NF_FILTER=m
CONFIG_IP_NF_TARGET_MASQUERADE=m
CONFIG_NETFILTER_XT_MATCH_ADDRTYPE=m
CONFIG_NETFILTER_XT_MATCH_CONNTRACK=m
CONFIG_NETFILTER_XT_MATCH_IPVS=m
CONFIG_IP_NF_NAT=m
CONFIG_NF_NAT=m
CONFIG_NF_NAT_NEEDED=y
CONFIG_POSIX_MQUEUE=y

# optional
CONFIG_USER_NS=y
CONFIG_SECCOMP=y
CONFIG_CGROUP_PIDS=y
CONFIG_MEMCG_SWAP=y
CONFIG_MEMCG_SWAP_ENABLED=y
CONFIG_BLK_CGROUP=y
CONFIG_BLK_DEV_THROTTLING=y
CONFIG_IOSCHED_CFQ=y
CONFIG_CFQ_GROUP_IOSCHED=y
CONFIG_CGROUP_PERF=y
CONFIG_CGROUP_HUGETLB=y
CONFIG_NET_CLS_CGROUP=y
CONFIG_CGROUP_NET_PRIO=y
CONFIG_CFS_BANDWIDTH=y
CONFIG_FAIR_GROUP_SCHED=y
CONFIG_RT_GROUP_SCHED=y
CONFIG_IP_NF_TARGET_REDIRECT=y
CONFIG_IP_VS=m
CONFIG_IP_VS_NFCT=y
CONFIG_IP_VS_PROTO_TCP=y
CONFIG_IP_VS_PROTO_UDP=y
CONFIG_IP_VS_RR=m
CONFIG_EXT4_FS=y
CONFIG_EXT4_FS_POSIX_ACL=y
CONFIG_EXT4_FS_SECURITY=y

# network
CONFIG_VXLAN=m

# storage
CONFIG_OVERLAY_FS=m

# kubeadm preflight

CONFIG_NETFILTER_XT_MATCH_COMMENT=m

# configs
CONFIG_IKCONFIG=y
CONFIG_IKCONFIG_PROC=y

# cdrom support
CONFIG_ISO9660_FS=m

# flannel network
CONFIG_IP_NF_MANGLE=m
CONFIG_IP_NF_TARGET_REJECT=m

CONFIG_NETFILTER_XT_MATCH_MARK=m
CONFIG_NETFILTER_XT_MATCH_STATISTIC=m

# distributed storage
CONFIG_NFS_FS=m
CONFIG_FUSE_FS=m
```
